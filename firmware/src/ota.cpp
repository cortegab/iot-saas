#include "ota.h"

#include <HTTPClient.h>
#include <Preferences.h>
#include <Update.h>
#include <WiFiClient.h>
#include <WiFiClientSecure.h>
#include <esp_ota_ops.h>
#include <esp_task_wdt.h>
#include <mbedtls/base64.h>
#include <mbedtls/pk.h>
#include <mbedtls/sha256.h>

#include "ota_keys.h"  // generated by ota_keys.py
#include "root_ca.h"
#include "version.h"

// The Arduino core marks a freshly updated app good as soon as it boots unless
// this says otherwise; we decide in otaLoop() instead (good once MQTT is up).
bool verifyRollbackLater() { return true; }

namespace {

constexpr unsigned long PROBATION_MS = 2UL * 60 * 1000;
constexpr unsigned long STALL_MS = 15000;
constexpr size_t MAX_SIGNATURE = 80;  // a DER ECDSA P-256 signature is at most 72 bytes

struct Request {
  String version, url, sha256, signature;
  size_t size = 0;
};

Request request;
bool pending = false;
bool onProbation = false;

// The "ota" object of the status message.
String reportVersion, reportState, reportError;
uint32_t reportSeq = 0;

void report(const String& version, const char* state, const String& error = String()) {
  reportVersion = version;
  reportState = state;
  reportError = error;
  reportSeq++;
  if (error.length() > 0)
    Serial.printf("[OTA] %s: %s (%s)\n", version.c_str(), state, error.c_str());
  else
    Serial.printf("[OTA] %s: %s\n", version.c_str(), state);
}

bool hexToBytes(const String& hex, uint8_t* out, size_t len) {
  if (hex.length() != len * 2) return false;
  for (size_t i = 0; i < len; i++) {
    char pair[3] = {hex[2 * i], hex[2 * i + 1], 0};
    char* end = nullptr;
    out[i] = (uint8_t)strtoul(pair, &end, 16);
    if (end != pair + 2) return false;
  }
  return true;
}

bool signatureOk(const uint8_t digest[32], const String& signatureB64) {
  uint8_t sig[MAX_SIGNATURE];
  size_t sigLen = 0;
  if (mbedtls_base64_decode(sig, sizeof(sig), &sigLen, (const unsigned char*)signatureB64.c_str(), signatureB64.length()) != 0)
    return false;
  for (size_t i = 0; i < OTA_KEY_COUNT; i++) {
    mbedtls_pk_context pk;
    mbedtls_pk_init(&pk);
    bool ok = mbedtls_pk_parse_public_key(&pk, (const unsigned char*)OTA_KEYS[i], strlen(OTA_KEYS[i]) + 1) == 0 &&
              mbedtls_pk_verify(&pk, MBEDTLS_MD_SHA256, digest, 32, sig, sigLen) == 0;
    mbedtls_pk_free(&pk);
    if (ok) return true;
  }
  return false;
}

// Downloads into the other slot and checks it. On success the slot is set to
// boot next; on failure it's abandoned and `err` says why.
bool install(const Request& r, String& err) {
  uint8_t want[32];
  if (!hexToBytes(r.sha256, want, sizeof(want))) {
    err = "the request's sha256 isn't 64 hex digits";
    return false;
  }
  WiFiClientSecure tls;
  WiFiClient plain;
  HTTPClient http;
  // HTTP is allowed (a dev server): the signature, not the transport, is what
  // proves the file is ours. HTTPS is checked against the same root as MQTT.
  bool https = r.url.startsWith("https://");
  if (https) {
    tls.setCACert(ROOT_CA);
    tls.setHandshakeTimeout(15);
  }
  if (!(https ? http.begin(tls, r.url) : http.begin(plain, r.url))) {
    err = "the download URL isn't valid";
    return false;
  }
  http.setTimeout(STALL_MS);
  int code = http.GET();
  if (code != HTTP_CODE_OK) {
    err = String("download failed: ") + (code > 0 ? String("HTTP ") + code : HTTPClient::errorToString(code));
    http.end();
    return false;
  }
  int length = http.getSize();
  if (length >= 0 && (size_t)length != r.size) {
    err = String("the server sent ") + length + " bytes, not " + r.size;
    http.end();
    return false;
  }
  if (!Update.begin(r.size, U_FLASH)) {
    err = String("can't start the update: ") + Update.errorString();
    http.end();
    return false;
  }
  mbedtls_sha256_context sha;
  mbedtls_sha256_init(&sha);
  mbedtls_sha256_starts(&sha, 0);
  WiFiClient* stream = http.getStreamPtr();
  static uint8_t buf[2048];
  size_t total = 0;
  unsigned long lastDataMs = millis();
  int lastPercent = -1;
  while (total < r.size) {
    esp_task_wdt_reset();  // a download takes longer than the loop watchdog
    size_t avail = stream->available();
    if (avail == 0) {
      if (millis() - lastDataMs > STALL_MS || (!stream->connected() && stream->available() == 0)) {
        err = String("the download stopped at ") + total + " of " + r.size + " bytes";
        break;
      }
      delay(5);
      continue;
    }
    size_t want_n = min(min(avail, sizeof(buf)), r.size - total);
    int n = stream->readBytes(buf, want_n);
    if (n <= 0) continue;
    mbedtls_sha256_update(&sha, buf, n);
    if (Update.write(buf, n) != (size_t)n) {
      err = String("writing the update failed: ") + Update.errorString();
      break;
    }
    total += n;
    lastDataMs = millis();
    int percent = (int)(total * 100 / r.size);
    if (percent / 10 != lastPercent / 10) Serial.printf("[OTA] %d%%\n", percent);
    lastPercent = percent;
  }
  http.end();
  uint8_t got[32];
  mbedtls_sha256_finish(&sha, got);
  mbedtls_sha256_free(&sha);
  if (err.length() == 0 && memcmp(got, want, sizeof(got)) != 0) err = "the file's SHA-256 doesn't match";
  if (err.length() == 0 && !signatureOk(got, r.signature))
    err = OTA_KEY_COUNT == 0 ? "this firmware has no update key" : "the signature doesn't match this firmware's update keys";
  if (err.length() > 0) {
    Update.abort();
    return false;
  }
  if (!Update.end(true)) {
    err = String("finishing the update failed: ") + Update.errorString();
    return false;
  }
  return true;
}

}  // namespace

void otaBegin() {
  const esp_partition_t* running = esp_ota_get_running_partition();
  esp_ota_img_states_t state;
  if (running != nullptr && esp_ota_get_state_partition(running, &state) == ESP_OK && state == ESP_OTA_IMG_PENDING_VERIFY) {
    onProbation = true;
    Serial.printf("[OTA] running %s on probation: it's kept once it reaches the broker within %lu min\n", FW_VERSION,
                  PROBATION_MS / 60000);
  }
  // The version an update restarted into (saved just before the restart). If
  // we're not it and not on probation, the bootloader went back: say so once.
  Preferences prefs;
  if (prefs.begin("iod-ota", false)) {
    String target = prefs.getString("target", "");
    if (target.length() > 0 && target != FW_VERSION && !onProbation) {
      report(target, "rolled_back", String("it didn't reach the broker; back on ") + FW_VERSION);
      prefs.remove("target");
    } else if (target == FW_VERSION && !onProbation) {
      prefs.remove("target");  // kept on an earlier boot
    }
    prefs.end();
  }
}

void otaLoop(bool mqttConnected) {
  if (!onProbation) return;
  if (mqttConnected) {
    esp_ota_mark_app_valid_cancel_rollback();
    onProbation = false;
    Preferences prefs;
    if (prefs.begin("iod-ota", false)) {
      prefs.remove("target");
      prefs.end();
    }
    Serial.printf("[OTA] %s reached the broker: kept\n", FW_VERSION);
    return;
  }
  if (millis() >= PROBATION_MS) {
    Serial.printf("[OTA] %s didn't reach the broker in %lu min: going back to the previous version\n", FW_VERSION,
                  PROBATION_MS / 60000);
    delay(100);
    esp_ota_mark_app_invalid_rollback_and_reboot();
  }
}

void otaRequest(const uint8_t* payload, unsigned int length) {
  JsonDocument doc;
  if (deserializeJson(doc, payload, length)) {
    Serial.println("[OTA] malformed update request, ignored");
    return;
  }
  Request r;
  r.version = doc["version"] | "";
  r.url = doc["url"] | "";
  r.sha256 = doc["sha256"] | "";
  r.signature = doc["signature"] | "";
  r.size = doc["size"] | (size_t)0;
  if (r.version.isEmpty() || r.url.isEmpty() || r.sha256.isEmpty() || r.signature.isEmpty() || r.size == 0) {
    report(r.version.isEmpty() ? String("?") : r.version, "failed", "the update request is missing a field");
    return;
  }
  if (r.version == FW_VERSION) {
    Serial.printf("[OTA] already running %s\n", FW_VERSION);
    return;
  }
  if (onProbation) {
    report(r.version, "failed", "the current version is still on probation; try again in a minute");
    return;
  }
  request = r;
  pending = true;
  report(r.version, "downloading");
}

bool otaPending() { return pending; }

void otaRun() {
  pending = false;
  String err;
  if (!install(request, err)) {
    report(request.version, "failed", err);
    return;
  }
  report(request.version, "restarting");
  Preferences prefs;
  if (prefs.begin("iod-ota", false)) {
    prefs.putString("target", request.version);
    prefs.end();
  }
  Serial.printf("[OTA] %s installed; restarting into it\n", request.version.c_str());
  delay(200);
  ESP.restart();
}

bool otaReport(JsonObject out) {
  if (reportState.isEmpty()) return false;
  out["version"] = reportVersion;
  out["state"] = reportState;
  if (reportError.length() > 0) out["error"] = reportError;
  return true;
}

uint32_t otaReportVersion() { return reportSeq; }
